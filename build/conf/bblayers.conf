## build/conf/bblayers.conf
```bitbake
# POKY_BBLAYERS_CONF_VERSION is increased each time build/conf/bblayers.conf
# changes incompatibly
POKY_BBLAYERS_CONF_VERSION = "2"

BBPATH = "${TOPDIR}"
BBFILES ?= ""

BBLAYERS ?= " \
  ${TOPDIR}/../oe-core/layers/poky/meta \
  ${TOPDIR}/../oe-core/layers/poky/meta-poky \
  ${TOPDIR}/../oe-core/layers/poky/meta-yocto-bsp \
  ${TOPDIR}/../oe-core/layers/meta-openembedded/meta-oe \
  ${TOPDIR}/../oe-core/layers/meta-openembedded/meta-python \
  ${TOPDIR}/../oe-core/layers/meta-openembedded/meta-networking \
  ${TOPDIR}/../oe-core/layers/meta-freescale \
  ${TOPDIR}/../oe-core/layers/meta-toradex-bsp-common \
  ${TOPDIR}/../oe-core/layers/meta-freescale-3rdparty \
  ${TOPDIR}/../oe-core/layers/meta-toradex-nxp \
  ${TOPDIR}/../oe-core/layers/meta-aebox \
  ${TOPDIR}/../oe-core/layers/meta-qt6 \
  ${TOPDIR}/../oe-core/layers/meta-toradex-distro \
  "
```

## meta-aebox/conf/machine/colibri-imx6ull-aebox.inc
```bitbake
# Append your custom DTS file
KERNEL_DEVICETREE_append = " imx6ull-aebox-custom-board-v3.dtb"
```
